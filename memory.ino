/*****************************************************************************

    File: "memory.ino"
    Date:  20/07/2023
    Copyright (C) 2023, Francisco J A Souza

    This file is part of EspAppleII Project.

    EspAppleII is free software; you can redistribute it and/or modify
    it under the terms of the GNU General Public License as published by
    the Free Software Foundation; either version 2 of the License, or
    (at your option) any later version.

    EspAppleII is distributed in the hope that it will be useful,
    but WITHOUT ANY WARRANTY; without even the implied warranty of
    MERCHANTABILITY or FITNESS FOR A PARTICULAR PURPOSE.  See the
    GNU General Public License for more details.

*****************************************************************************/

#include "video.h"

const unsigned char DISK_ROM[] PROGMEM = { //$C600 - C6FFF
        0xa2, 0x20, 0xa0, 0x00, 0xa2, 0x03, 0x86, 0x3c, 0x8a, 0x0a, 0x24, 0x3c, 0xf0, 0x10, 0x05, 0x3c, 
        0x49, 0xff, 0x29, 0x7e, 0xb0, 0x08, 0x4a, 0xd0, 0xfb, 0x98, 0x9d, 0x56, 0x03, 0xc8, 0xe8, 0x10, 
        0xe5, 0x20, 0x58, 0xff, 0xba, 0xbd, 0x00, 0x01, 0x0a, 0x0a, 0x0a, 0x0a, 0x85, 0x2b, 0xaa, 0xbd, 
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        0x3d, 0xcd, 0x00, 0x08, 0xa6, 0x2b, 0x90, 0xdb, 0x4c, 0x01, 0x08, 0x00, 0x00, 0x00, 0x00, 0x00
};

const unsigned char ROM[] PROGMEM = { //$D000 - FFFF
        0x6F, 0xD8, 0x65, 0xD7, 0xF8, 0xDC, 0x94, 0xD9, 0xB1, 0xDB, 0x30, 0xF3, 0xD8, 0xDF, 0xE1, 0xDB,
        0x8F, 0xF3, 0x98, 0xF3, 0xE4, 0xF1, 0xDD, 0xF1, 0xD4, 0xF1, 0x24, 0xF2, 0x31, 0xF2, 0x40, 0xF2,
        0xD7, 0xF3, 0xE1, 0xF3, 0xE8, 0xF6, 0xFD, 0xF6, 0x68, 0xF7, 0x6E, 0xF7, 0xE6, 0xF7, 0x57, 0xFC,
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        0x83, 0x7F, 0x5D, 0xCC, 0xB5, 0xFC, 0x17, 0x17, 0xF5, 0x03, 0xFB, 0x03, 0x62, 0xFA, 0x59, 0xFF
};

unsigned char memlcramr;                /* read LC RAM or ROM?                                  */
unsigned char memlcramw;                /* write LC RAM or ROM?                                 */
unsigned char memlcbank2;               /* read from LC bank 1 or LC bank 2                     */
static bool memlcprewrite;               /* first odd-switch access arms LC writes               */
static bool iie80Store;
static bool iieRamReadAux;
static bool iieRamWriteAux;
static bool iieIntCxROM;
static bool iieAltZeroPage;
static bool iieSlotC3ROM;
static bool iieInternalC8ROM;
bool iie80Column;
bool iieAltCharset;
bool iieDoubleHires;

static bool IIeUseAuxiliaryRAM(unsigned short address, bool writing);

#if ENABLE_CPU_TRACE
static const unsigned short MEMORY_PROVENANCE_FIRST = MEMORY_DIAGNOSTIC_FIRST;
static const unsigned short MEMORY_PROVENANCE_LAST = MEMORY_DIAGNOSTIC_LAST;
static const unsigned int MEMORY_PROVENANCE_BYTES =
  MEMORY_PROVENANCE_LAST - MEMORY_PROVENANCE_FIRST + 1;
static const unsigned int MEMORY_PROVENANCE_BANKS =
  MEMORY_PROVENANCE_FIRST >= 0xD000 ? 4 : 2;
static const unsigned short MEMORY_SOURCE_FIRST = MEMORY_DIAGNOSTIC_SOURCE_FIRST;
static const unsigned short MEMORY_SOURCE_LAST = MEMORY_DIAGNOSTIC_SOURCE_LAST;
static const unsigned int MEMORY_SOURCE_BYTES =
  MEMORY_SOURCE_LAST - MEMORY_SOURCE_FIRST + 1;
static const unsigned int MEMORY_SOURCE_BANKS = 2;
static const unsigned short COPY_SOURCE_FIRST = 0x58D0;
static const unsigned short COPY_SOURCE_LAST = 0x58F8;
static const unsigned int COPY_SOURCE_BYTES =
  COPY_SOURCE_LAST - COPY_SOURCE_FIRST + 1;

enum LCSourceKind : uint8_t {
  LC_SOURCE_UNKNOWN = 0,
  LC_SOURCE_IMMEDIATE,
  LC_SOURCE_MEMORY,
  LC_SOURCE_REGISTER,
  LC_SOURCE_GENERATED
};

// Four independent tables prevent later activity in one LC bank from
// displacing the writes which populated another. The target range is small
// enough to retain first and latest provenance for every byte until reset.
struct __attribute__((packed)) LCByteProvenance {
  uint64_t firstCycle;
  uint64_t latestCycle;
  uint16_t firstPC;
  uint16_t latestPC;
  uint16_t firstSourceAddress;
  uint16_t writeCount;
  uint16_t firstPreviousPC;
  uint16_t firstPreviousArgument;
  uint8_t firstOldValue;
  uint8_t firstNewValue;
  uint8_t latestOldValue;
  uint8_t latestNewValue;
  uint8_t latestOpcode;
  uint8_t firstFlags;
  uint8_t firstOpcode;
  uint8_t firstA;
  uint8_t firstX;
  uint8_t firstY;
  uint8_t firstPreviousOpcode;
  uint8_t firstSourceKind;
};

struct LCWriterContext {
  bool valid;
  uint8_t bankIndex;
  uint16_t writerPC;
  uint16_t targetAddress;
  uint8_t opcode;
  uint8_t value;
  uint8_t a;
  uint8_t x;
  uint8_t y;
  uint16_t recentPC[16];
  uint8_t recentOpcode[16];
  uint16_t recentArgument[16];
};

struct __attribute__((packed)) MemoryControlFlowEntry {
  uint64_t cycles;
  uint16_t pc;
  uint16_t effectiveAddress;
  uint16_t nextPC;
  uint16_t target;
  uint16_t fallThrough;
  uint8_t opcode;
  uint8_t a;
  uint8_t x;
  uint8_t y;
  uint8_t sp;
  uint8_t sr;
  uint8_t kind;
  uint8_t taken;
};

struct __attribute__((packed)) MemoryLightHistoryEntry {
  uint16_t pc;
  uint16_t effectiveAddress;
  uint16_t nextPC;
  uint8_t opcode;
  uint8_t sr;
};

struct __attribute__((packed)) CopySourceSnapshotEntry {
  uint64_t writerCycle;
  uint16_t writerPC;
  uint8_t value;
  uint8_t bankIndex;
  uint8_t writeCountKnown;
};

static LCByteProvenance * LCProvenance = NULL;
static LCByteProvenance * SourceProvenance = NULL;
static CopySourceSnapshotEntry * CopySourceBefore = NULL;
static bool CopySourceBeforeCaptured = false;
static uint64_t CopySourceReadCycle = 0;
static uint16_t CopySourceReaderPC = 0;
static const unsigned int LC_WRITER_CONTEXTS = 8;
static LCWriterContext * LCWriterContexts = NULL;
static const unsigned int MEMORY_LIGHT_HISTORY_SIZE = 64;
static MemoryLightHistoryEntry * MemoryLightHistory = NULL;
static unsigned int MemoryLightHistoryCount = 0;
static unsigned int MemoryLightHistoryNext = 0;
static const unsigned int MEMORY_CONTROL_FLOW_SIZE = 256;
static MemoryControlFlowEntry * MemoryControlFlow = NULL;
static unsigned int MemoryControlFlowCount = 0;
static unsigned int MemoryControlFlowNext = 0;
static bool MemoryDiagnosticCaptured = false;
static bool MemoryDetailedFlowDumped = false;

static bool EnsureIIeProvenanceDiagnosticsStorage() {
  size_t provenanceBytes = sizeof(LCByteProvenance) *
                           MEMORY_PROVENANCE_BANKS * MEMORY_PROVENANCE_BYTES;
  size_t sourceProvenanceBytes = sizeof(LCByteProvenance) *
                                 MEMORY_SOURCE_BANKS * MEMORY_SOURCE_BYTES;
  if (!LCProvenance) {
    LCProvenance = (LCByteProvenance *) heap_caps_malloc(
      provenanceBytes, MALLOC_CAP_INTERNAL | MALLOC_CAP_8BIT);
    if (LCProvenance)
      memset(LCProvenance, 0,
             sizeof(LCByteProvenance) * MEMORY_PROVENANCE_BANKS *
             MEMORY_PROVENANCE_BYTES);
  }
  if (!SourceProvenance) {
    SourceProvenance = (LCByteProvenance *) heap_caps_malloc(
      sourceProvenanceBytes, MALLOC_CAP_INTERNAL | MALLOC_CAP_8BIT);
    if (SourceProvenance)
      memset(SourceProvenance, 0, sourceProvenanceBytes);
  }
  if (!CopySourceBefore) {
    CopySourceBefore = (CopySourceSnapshotEntry *) heap_caps_malloc(
      sizeof(CopySourceSnapshotEntry) * COPY_SOURCE_BYTES,
      MALLOC_CAP_INTERNAL | MALLOC_CAP_8BIT);
    if (CopySourceBefore)
      memset(CopySourceBefore, 0,
             sizeof(CopySourceSnapshotEntry) * COPY_SOURCE_BYTES);
  }
  if (!LCWriterContexts) {
    LCWriterContexts = (LCWriterContext *) heap_caps_malloc(
      sizeof(LCWriterContext) * LC_WRITER_CONTEXTS,
      MALLOC_CAP_INTERNAL | MALLOC_CAP_8BIT);
    if (LCWriterContexts)
      memset(LCWriterContexts, 0,
             sizeof(LCWriterContext) * LC_WRITER_CONTEXTS);
  }
  if (!MemoryControlFlow) {
    MemoryControlFlow = (MemoryControlFlowEntry *) heap_caps_malloc(
      sizeof(MemoryControlFlowEntry) * MEMORY_CONTROL_FLOW_SIZE,
      MALLOC_CAP_INTERNAL | MALLOC_CAP_8BIT);
    if (MemoryControlFlow)
      memset(MemoryControlFlow, 0,
             sizeof(MemoryControlFlowEntry) * MEMORY_CONTROL_FLOW_SIZE);
  }
  if (!MemoryLightHistory) {
    MemoryLightHistory = (MemoryLightHistoryEntry *) heap_caps_malloc(
      sizeof(MemoryLightHistoryEntry) * MEMORY_LIGHT_HISTORY_SIZE,
      MALLOC_CAP_INTERNAL | MALLOC_CAP_8BIT);
    if (MemoryLightHistory)
      memset(MemoryLightHistory, 0,
             sizeof(MemoryLightHistoryEntry) * MEMORY_LIGHT_HISTORY_SIZE);
  }
  return LCProvenance != NULL && SourceProvenance != NULL &&
         CopySourceBefore != NULL && LCWriterContexts != NULL &&
         MemoryControlFlow != NULL && MemoryLightHistory != NULL;
}

void InitializeMemoryProvenanceDiagnostics() {
  bool ready = EnsureIIeProvenanceDiagnosticsStorage();
  size_t requested = sizeof(LCByteProvenance) * MEMORY_PROVENANCE_BANKS *
                     MEMORY_PROVENANCE_BYTES +
                     sizeof(LCByteProvenance) * MEMORY_SOURCE_BANKS *
                     MEMORY_SOURCE_BYTES +
                     sizeof(CopySourceSnapshotEntry) * COPY_SOURCE_BYTES +
                     sizeof(LCWriterContext) * LC_WRITER_CONTEXTS +
                     sizeof(MemoryControlFlowEntry) * MEMORY_CONTROL_FLOW_SIZE +
                     sizeof(MemoryLightHistoryEntry) * MEMORY_LIGHT_HISTORY_SIZE;
  if (ready) {
    DEBUG_PRINTF("[LC-PROV] storage ready bytes=%u allocator=internal-8bit "
                 "location=%p flow=%p freeHeap=%u maxAlloc=%u "
                 "freePSRAM=%u largestPSRAM=%u\n",
                 (unsigned) requested, LCProvenance, MemoryControlFlow,
                 ESP.getFreeHeap(), ESP.getMaxAllocHeap(),
                 (unsigned) heap_caps_get_free_size(MALLOC_CAP_SPIRAM),
                 (unsigned) heap_caps_get_largest_free_block(MALLOC_CAP_SPIRAM));
  } else {
    DEBUG_PRINTF("[LC-PROV] storage allocation FAILED requested=%u "
                 "allocator=heap_caps_malloc(INTERNAL|8BIT) provenance=%p "
                 "source=%p contexts=%p flow=%p freeHeap=%u maxAlloc=%u "
                 "freePSRAM=%u largestPSRAM=%u\n",
                 (unsigned) requested, LCProvenance, SourceProvenance,
                 LCWriterContexts,
                 MemoryControlFlow, ESP.getFreeHeap(), ESP.getMaxAllocHeap(),
                 (unsigned) heap_caps_get_free_size(MALLOC_CAP_SPIRAM),
                 (unsigned) heap_caps_get_largest_free_block(MALLOC_CAP_SPIRAM));
  }
  DEBUG_PRINTF("[MEM-DIAG] bounds=%04X-%04X sourceWatch=%04X-%04X "
               "trigger=%04X-%04X lightweight=1 recent=%u detailedAfterTrigger=%u\n",
               MEMORY_PROVENANCE_FIRST, MEMORY_PROVENANCE_LAST,
               MEMORY_SOURCE_FIRST, MEMORY_SOURCE_LAST,
               MEMORY_DIAGNOSTIC_TRIGGER_FIRST,
               MEMORY_DIAGNOSTIC_TRIGGER_LAST,
               MEMORY_LIGHT_HISTORY_SIZE, MEMORY_CONTROL_FLOW_SIZE);
}

static void ResetIIeProvenanceDiagnostics() {
  EnsureIIeProvenanceDiagnosticsStorage();
  if (LCProvenance)
    memset(LCProvenance, 0,
           sizeof(LCByteProvenance) * MEMORY_PROVENANCE_BANKS *
           MEMORY_PROVENANCE_BYTES);
  if (SourceProvenance)
    memset(SourceProvenance, 0,
           sizeof(LCByteProvenance) * MEMORY_SOURCE_BANKS *
           MEMORY_SOURCE_BYTES);
  if (CopySourceBefore)
    memset(CopySourceBefore, 0,
           sizeof(CopySourceSnapshotEntry) * COPY_SOURCE_BYTES);
  CopySourceBeforeCaptured = false;
  CopySourceReadCycle = 0;
  CopySourceReaderPC = 0;
  if (LCWriterContexts)
    memset(LCWriterContexts, 0,
           sizeof(LCWriterContext) * LC_WRITER_CONTEXTS);
  if (MemoryControlFlow)
    memset(MemoryControlFlow, 0,
           sizeof(MemoryControlFlowEntry) * MEMORY_CONTROL_FLOW_SIZE);
  if (MemoryLightHistory)
    memset(MemoryLightHistory, 0,
           sizeof(MemoryLightHistoryEntry) * MEMORY_LIGHT_HISTORY_SIZE);
  MemoryLightHistoryCount = 0;
  MemoryLightHistoryNext = 0;
  MemoryControlFlowCount = 0;
  MemoryControlFlowNext = 0;
  MemoryDiagnosticCaptured = false;
  MemoryDetailedFlowDumped = false;
}

static LCByteProvenance * LCProvenanceEntry(unsigned int bankIndex,
                                             unsigned short address) {
  if (address >= MEMORY_PROVENANCE_FIRST &&
      address <= MEMORY_PROVENANCE_LAST) {
    if (!LCProvenance || bankIndex >= MEMORY_PROVENANCE_BANKS) return NULL;
    return &LCProvenance[bankIndex * MEMORY_PROVENANCE_BYTES +
                         address - MEMORY_PROVENANCE_FIRST];
  }
  if (address >= MEMORY_SOURCE_FIRST && address <= MEMORY_SOURCE_LAST) {
    if (!SourceProvenance || bankIndex >= MEMORY_SOURCE_BANKS) return NULL;
    return &SourceProvenance[bankIndex * MEMORY_SOURCE_BYTES +
                             address - MEMORY_SOURCE_FIRST];
  }
  return NULL;
}

static unsigned int MemoryProvenanceBankIndex(unsigned short address,
                                               bool writing) {
  if (address < 0xD000)
    return IIeUseAuxiliaryRAM(address, writing) ? 1U : 0U;
  return (iieAltZeroPage ? 2U : 0U) + (memlcbank2 ? 1U : 0U);
}

static const char * MemoryProvenanceBankName(unsigned int bankIndex) {
  static const char * const ramNames[2] = { "main-ram", "aux-ram" };
  static const char * const lcNames[4] = {
    "main-lc-bank1", "main-lc-bank2", "aux-lc-bank1", "aux-lc-bank2"
  };
  if (bankIndex >= MEMORY_PROVENANCE_BANKS) return "unknown-bank";
  return MEMORY_PROVENANCE_FIRST >= 0xD000 ? lcNames[bankIndex]
                                            : ramNames[bankIndex];
}

static const char * MemoryProvenanceBankNameForAddress(
  unsigned int bankIndex, unsigned short address) {
  if (address < 0xD000) {
    static const char * const ramNames[2] = { "main-ram", "aux-ram" };
    return bankIndex < 2 ? ramNames[bankIndex] : "unknown-ram";
  }
  return MemoryProvenanceBankName(bankIndex);
}

static const char * LCSourceKindName(unsigned int sourceKind) {
  switch (sourceKind) {
    case LC_SOURCE_IMMEDIATE: return "immediate";
    case LC_SOURCE_MEMORY: return "memory";
    case LC_SOURCE_REGISTER: return "register";
    case LC_SOURCE_GENERATED: return "generated";
    default: return "unknown";
  }
}

static bool IsAccumulatorLoad(unsigned char op) {
  switch (op) {
    case 0xA1: case 0xA5: case 0xA9: case 0xAD:
    case 0xB1: case 0xB5: case 0xB9: case 0xBD:
      return true;
  }
  return false;
}

static bool IsAccumulatorStore(unsigned char op) {
  switch (op) {
    case 0x81: case 0x85: case 0x8D: case 0x91:
    case 0x95: case 0x99: case 0x9D:
      return true;
  }
  return false;
}

static void CaptureLCWriterContext(unsigned int bankIndex,
                                   unsigned short address,
                                   unsigned char value) {
  if (address < MEMORY_DIAGNOSTIC_TRIGGER_FIRST ||
      address > MEMORY_DIAGNOSTIC_TRIGGER_LAST)
    return;
  if (!LCWriterContexts)
    return;
  for (unsigned int i = 0; i < LC_WRITER_CONTEXTS; i++) {
    if (LCWriterContexts[i].valid &&
        LCWriterContexts[i].bankIndex == bankIndex &&
        LCWriterContexts[i].writerPC == CPUInstructionStartPC)
      return;
  }
  LCWriterContext * context = NULL;
  for (unsigned int i = 0; i < LC_WRITER_CONTEXTS; i++) {
    if (!LCWriterContexts[i].valid) {
      context = &LCWriterContexts[i];
      break;
    }
  }
  if (!context)
    return;
  context->valid = true;
  context->bankIndex = bankIndex;
  context->writerPC = CPUInstructionStartPC;
  context->targetAddress = address;
  context->opcode = opcode;
  context->value = value;
  context->a = A;
  context->x = X;
  context->y = Y;
  for (unsigned int offset = 0; offset < 16; offset++) {
    unsigned char historyIndex = (CPURecentIndex + offset) & 0x0F;
    context->recentPC[offset] = CPURecentPC[historyIndex];
    context->recentOpcode[offset] = CPURecentOpcode[historyIndex];
    context->recentArgument[offset] = CPURecentArgument[historyIndex];
  }
}

static void RecordLCWrite(unsigned short address, unsigned char oldValue,
                          unsigned char newValue) {
  bool destination = address >= MEMORY_PROVENANCE_FIRST &&
                     address <= MEMORY_PROVENANCE_LAST;
  bool source = address >= MEMORY_SOURCE_FIRST &&
                address <= MEMORY_SOURCE_LAST;
  if (!destination && !source)
    return;
  // Validation harnesses can bypass normal post-startup initialization, so
  // retain a guarded allocation fallback on the first relevant LC write.
  if (!EnsureIIeProvenanceDiagnosticsStorage())
    return;
  unsigned int bankIndex = MemoryProvenanceBankIndex(address, true);
  LCByteProvenance * entry = LCProvenanceEntry(bankIndex, address);
  if (!entry)
    return;
  uint8_t flags = (memlcramr ? 0x01 : 0) |
                  (memlcramw ? 0x02 : 0) |
                  (iieRamReadAux ? 0x04 : 0) |
                  (iieRamWriteAux ? 0x08 : 0) |
                  (iieAltZeroPage ? 0x10 : 0);
  if (!entry->writeCount) {
    unsigned char previousIndex = (CPURecentIndex + 15) & 0x0F;
    unsigned char previousOpcode = CPURecentOpcode[previousIndex];
    unsigned short previousArgument = CPURecentArgument[previousIndex];
    entry->firstCycle = TotalCycles;
    entry->firstPC = CPUInstructionStartPC;
    entry->firstOldValue = oldValue;
    entry->firstNewValue = newValue;
    entry->firstFlags = flags;
    entry->firstOpcode = opcode;
    entry->firstA = A;
    entry->firstX = X;
    entry->firstY = Y;
    entry->firstPreviousPC = CPURecentPC[previousIndex];
    entry->firstPreviousOpcode = previousOpcode;
    entry->firstPreviousArgument = previousArgument;
    entry->firstSourceAddress = 0xFFFF;
    entry->firstSourceKind = LC_SOURCE_UNKNOWN;
    if (IsAccumulatorStore(opcode)) {
      entry->firstSourceKind = LC_SOURCE_REGISTER;
      if (IsAccumulatorLoad(previousOpcode) && A == newValue) {
        if (previousOpcode == 0xA9) {
          entry->firstSourceKind = LC_SOURCE_IMMEDIATE;
          entry->firstSourceAddress = CPURecentPC[previousIndex] + 1;
        } else {
          entry->firstSourceKind = LC_SOURCE_MEMORY;
          entry->firstSourceAddress = previousArgument;
        }
      }
    } else if (opcode == 0x86 || opcode == 0x8E || opcode == 0x96 ||
               opcode == 0x84 || opcode == 0x8C || opcode == 0x94) {
      entry->firstSourceKind = LC_SOURCE_REGISTER;
    } else {
      entry->firstSourceKind = LC_SOURCE_GENERATED;
    }
    CaptureLCWriterContext(bankIndex, address, newValue);
  }
  if (entry->writeCount != 0xFFFF)
    entry->writeCount++;
  entry->latestCycle = TotalCycles;
  entry->latestPC = CPUInstructionStartPC;
  entry->latestOldValue = oldValue;
  entry->latestNewValue = newValue;
  entry->latestOpcode = opcode;
}
#else
static void ResetIIeProvenanceDiagnostics() {}
void InitializeMemoryProvenanceDiagnostics() {}
#endif

bool IIe80StoreEnabled() {
  return IsIIeMode() && iie80Store;
}

void ResetIIeSoftSwitches() {
  iie80Store = false;
  iieRamReadAux = false;
  iieRamWriteAux = false;
  iieIntCxROM = false;
  iieAltZeroPage = false;
  iieSlotC3ROM = false;
  iieInternalC8ROM = false;
  iie80Column = false;
  iieAltCharset = false;
  iieDoubleHires = false;
}

void ResetMemorySoftSwitches() {
  // Power-on state: motherboard ROM visible and language-card writes locked.
  // This must happen before reading the reset vector for a newly selected game.
  memlcramr = 0;
  memlcramw = 0;
  memlcbank2 = 0;
  memlcprewrite = false;
  ResetIIeSoftSwitches();
  ResetIIeProvenanceDiagnostics();
}
int k=0;
static uint64_t paddleResetCycle = 0;

static unsigned int LanguageCardIndex(unsigned short address) {
  // A 16K language card has two independent 4K banks at $D000-$DFFF and
  // one shared 8K region at $E000-$FFFF.
  if (address < 0xE000)
    return (memlcbank2 ? 0x1000 : 0x0000) + (address - 0xD000);
  return 0x2000 + (address - 0xE000);
}

static bool IIeUseAuxiliaryRAM(unsigned short address, bool writing) {
  if (!IsIIeMode() || !AUXRAM)
    return false;
  if (address < 0x0200)
    return iieAltZeroPage;
  bool auxiliary = writing ? iieRamWriteAux : iieRamReadAux;
  if (iie80Store && address >= 0x0400 && address < 0x0800)
    auxiliary = (gm & PG2) != 0;
  if (iie80Store && (gm & HRG) && address >= 0x2000 && address < 0x4000)
    auxiliary = (gm & PG2) != 0;
  return auxiliary;
}

static unsigned char IIeStatus(bool enabled) {
  return (enabled ? 0x80 : 0x00) | (k & 0x7f);
}

void PrintIIeMemoryDiagnostic(unsigned short address) {
#if ENABLE_CPU_TRACE
  unsigned char visibleLow = read8(address);
  unsigned char visibleHigh = read8(address + 1);
  unsigned char mainLow = 0, mainHigh = 0, auxLow = 0, auxHigh = 0;
  if (address < 0xBFFF) {
    mainLow = RAM[address];
    mainHigh = RAM[address + 1];
    if (AUXRAM) {
      auxLow = AUXRAM[address];
      auxHigh = AUXRAM[address + 1];
    }
  } else if (address >= 0xD000 && address < 0xFFFF) {
    unsigned int lowIndex = LanguageCardIndex(address);
    unsigned int highIndex = LanguageCardIndex(address + 1);
    mainLow = RAMEXT[lowIndex];
    mainHigh = RAMEXT[highIndex];
    if (AUXRAMEXT) {
      auxLow = AUXRAMEXT[lowIndex];
      auxHigh = AUXRAMEXT[highIndex];
    }
  }
  DEBUG_PRINTF("[CPU-MEM] pointer=%04X visible=%02X%02X main=%02X%02X aux=%02X%02X LCRAMR=%u LCRAMW=%u LCBANK2=%u RAMRD=%u RAMWRT=%u ALTZP=%u 80STORE=%u PAGE2=%u HIRES=%u\n",
               address, visibleHigh, visibleLow, mainHigh, mainLow,
               auxHigh, auxLow, (unsigned) (memlcramr != 0),
               (unsigned) (memlcramw != 0), (unsigned) (memlcbank2 != 0),
               (unsigned) iieRamReadAux, (unsigned) iieRamWriteAux,
               (unsigned) iieAltZeroPage, (unsigned) iie80Store,
               (unsigned) ((gm & PG2) != 0), (unsigned) ((gm & HRG) != 0));
#else
  (void) address;
#endif
}

#if ENABLE_CPU_TRACE
static void DumpMappedMemoryRange(const char * label, unsigned short first,
                                  unsigned short last) {
  DEBUG_PRINTF("[CPU-MEM] %s %04X-%04X:\n", label, first, last);
  for (unsigned int line = first; line <= last; line += 16) {
    DEBUG_PRINTF("[CPU-MEM] %04X:", line);
    unsigned int lineLast = line + 15;
    if (lineLast > last) lineLast = last;
    for (unsigned int address = line; address <= lineLast; address++)
      DEBUG_PRINTF(" %02X", read8((unsigned short) address));
    DEBUG_PRINTLN();
  }
}

static void DumpBackingMemoryRange(const char * label,
                                   const unsigned char * buffer,
                                   unsigned int backingOffset,
                                   unsigned short first,
                                   unsigned short last) {
  DEBUG_PRINTF("[CPU-MEM] %s %04X-%04X host=%p offset=%04X:\n",
               label, first, last, buffer, backingOffset);
  if (!buffer) {
    DEBUG_PRINTLN("[CPU-MEM] unavailable");
    return;
  }
  for (unsigned int line = first; line <= last; line += 16) {
    DEBUG_PRINTF("[CPU-MEM] %04X:", line);
    unsigned int lineLast = line + 15;
    if (lineLast > last) lineLast = last;
    for (unsigned int address = line; address <= lineLast; address++)
      DEBUG_PRINTF(" %02X", buffer[backingOffset + address - first]);
    DEBUG_PRINTLN();
  }
}

static bool MappedRangeMatchesBacking(const unsigned char * buffer,
                                      unsigned int backingOffset,
                                      unsigned short first,
                                      unsigned short last) {
  if (!buffer) return false;
  for (unsigned int address = first; address <= last; address++) {
    if (read8((unsigned short) address) !=
        buffer[backingOffset + address - first])
      return false;
  }
  return true;
}

static void DumpLCProvenanceEntry(unsigned int bankIndex,
                                  unsigned short address,
                                  const LCByteProvenance * entry) {
  DEBUG_PRINTF("[LC-PROV] %04X bank=%s writes=%u "
               "firstCycle=%llu firstPC=%04X first=%02X->%02X "
               "latestCycle=%llu latestPC=%04X latest=%02X->%02X "
               "opcode=%02X A=%02X X=%02X Y=%02X source=%s",
               address, MemoryProvenanceBankNameForAddress(bankIndex, address),
               entry->writeCount,
               entry->firstCycle, entry->firstPC, entry->firstOldValue,
               entry->firstNewValue, entry->latestCycle, entry->latestPC,
               entry->latestOldValue, entry->latestNewValue,
               entry->firstOpcode, entry->firstA, entry->firstX,
               entry->firstY, LCSourceKindName(entry->firstSourceKind));
  if (entry->firstSourceAddress != 0xFFFF)
    DEBUG_PRINTF("@%04X", entry->firstSourceAddress);
  DEBUG_PRINTF(" previous=%04X:%02X@%04X "
               "LCRAMR=%u LCRAMW=%u RAMRD=%u RAMWRT=%u ALTZP=%u\n",
               entry->firstPreviousPC, entry->firstPreviousOpcode,
               entry->firstPreviousArgument,
               (entry->firstFlags & 0x01) != 0,
               (entry->firstFlags & 0x02) != 0,
               (entry->firstFlags & 0x04) != 0,
               (entry->firstFlags & 0x08) != 0,
               (entry->firstFlags & 0x10) != 0);
}

static void DumpLCWriterContexts() {
  if (!LCWriterContexts) {
    DEBUG_PRINTLN("[LC-PROV] writer-context storage unavailable");
    return;
  }
  for (unsigned int i = 0; i < LC_WRITER_CONTEXTS; i++) {
    const LCWriterContext * context = &LCWriterContexts[i];
    if (!context->valid)
      continue;
    DEBUG_PRINTF("[LC-PROV] writer-context bank=%s target=%04X pc=%04X "
                 "opcode=%02X value=%02X A=%02X X=%02X Y=%02X history:",
                 MemoryProvenanceBankNameForAddress(context->bankIndex,
                                                    context->targetAddress),
                 context->targetAddress, context->writerPC, context->opcode,
                 context->value, context->a, context->x, context->y);
    for (unsigned int j = 0; j < 16; j++)
      DEBUG_PRINTF(" %04X:%02X@%04X", context->recentPC[j],
                   context->recentOpcode[j], context->recentArgument[j]);
    DEBUG_PRINTLN();
  }
}

static unsigned char MemoryProvenanceBackingValue(unsigned int bankIndex,
                                                   unsigned short address) {
  if (address < 0xD000) {
    if (bankIndex == 0) return RAM[address];
    if (bankIndex == 1) return AUXRAM ? AUXRAM[address] : 0;
    return 0;
  }
  bool auxiliary = bankIndex >= 2;
  bool bank2 = (bankIndex & 1) != 0;
  unsigned char * buffer = auxiliary ? AUXRAMEXT : RAMEXT;
  unsigned int backingIndex = (bank2 ? 0x1000 : 0) + address - 0xD000;
  return buffer ? buffer[backingIndex] : 0;
}

static void DumpLCTargetSummary(unsigned int selectedBankIndex) {
  const unsigned short targetFirst = MEMORY_DIAGNOSTIC_TRIGGER_FIRST;
  const unsigned short targetLast = MEMORY_DIAGNOSTIC_TRIGGER_LAST;
  DEBUG_PRINTF("[LC-PROV] target %04X-%04X selected=%s:\n",
               targetFirst, targetLast,
               MemoryProvenanceBankName(selectedBankIndex));
  for (unsigned short address = targetFirst; address <= targetLast; address++) {
    const LCByteProvenance * entry =
      LCProvenanceEntry(selectedBankIndex, address);
    unsigned char value =
      MemoryProvenanceBackingValue(selectedBankIndex, address);
    if (!entry || !entry->writeCount) {
      DEBUG_PRINTF("[LC-PROV] %04X=%02X writer=unrecorded\n", address, value);
      continue;
    }
    DEBUG_PRINTF("[LC-PROV] %04X=%02X writer=%04X:%02X writes=%u source=%s",
                 address, value, entry->firstPC, entry->firstOpcode,
                 entry->writeCount, LCSourceKindName(entry->firstSourceKind));
    if (entry->firstSourceAddress != 0xFFFF)
      DEBUG_PRINTF("@%04X", entry->firstSourceAddress);
    DEBUG_PRINTLN();
  }

  unsigned short runFirst = targetFirst;
  while (runFirst <= targetLast) {
    const LCByteProvenance * firstEntry =
      LCProvenanceEntry(selectedBankIndex, runFirst);
    if (!firstEntry) {
      DEBUG_PRINTLN("[LC-PROV] provenance storage unavailable");
      return;
    }
    unsigned short runLast = runFirst;
    while (runLast < targetLast) {
      const LCByteProvenance * next =
        LCProvenanceEntry(selectedBankIndex, runLast + 1);
      if (!firstEntry->writeCount || !next->writeCount ||
          next->firstPC != firstEntry->firstPC ||
          next->firstOpcode != firstEntry->firstOpcode ||
          next->firstSourceKind != firstEntry->firstSourceKind)
        break;
      runLast++;
    }
    if (firstEntry->writeCount && runLast > runFirst) {
      const char * classification = "repeated-writer; classification uncertain";
      if (firstEntry->firstSourceKind == LC_SOURCE_MEMORY)
        classification = "memory-copy pattern";
      else if (firstEntry->firstSourceKind == LC_SOURCE_IMMEDIATE)
        classification = "immediate/fill pattern";
      else if (firstEntry->firstSourceKind == LC_SOURCE_GENERATED)
        classification = "generated/RMW pattern";
      DEBUG_PRINTF("[LC-PROV] pattern %04X-%04X writer=%04X:%02X %s\n",
                   runFirst, runLast, firstEntry->firstPC,
                   firstEntry->firstOpcode, classification);
    }
    runFirst = runLast + 1;
  }
}

static void DumpCriticalD6Writers(unsigned int selectedBankIndex) {
  const unsigned short first = 0xD6E8;
  const unsigned short last = 0xD6EF;
  DEBUG_PRINTF("[D6-WRITER] BEGIN D6E8-D6EF diskAB=%c selected=%s\n",
#if DISK_WRITE_AB_MODE == DISK_WRITE_AB_READ_ONLY
               'B',
#else
               'A',
#endif
               MemoryProvenanceBankName(selectedBankIndex));
  for (unsigned short address = first; address <= last; address++) {
    bool found = false;
    for (unsigned int bankIndex = 0;
         bankIndex < MEMORY_PROVENANCE_BANKS; bankIndex++) {
      const LCByteProvenance * entry = LCProvenanceEntry(bankIndex, address);
      if (!entry || !entry->writeCount)
        continue;
      found = true;
      DEBUG_PRINTF("[D6-WRITER] %04X bank=%s value=%02X writes=%u "
                   "first=%llu:%04X:%02X:%02X->%02X "
                   "latest=%llu:%04X:%02X:%02X->%02X source=%s",
                   address,
                   MemoryProvenanceBankNameForAddress(bankIndex, address),
                   MemoryProvenanceBackingValue(bankIndex, address),
                   entry->writeCount, entry->firstCycle, entry->firstPC,
                   entry->firstOpcode, entry->firstOldValue,
                   entry->firstNewValue, entry->latestCycle,
                   entry->latestPC, entry->latestOpcode,
                   entry->latestOldValue, entry->latestNewValue,
                   LCSourceKindName(entry->firstSourceKind));
      if (entry->firstSourceAddress != 0xFFFF)
        DEBUG_PRINTF("@%04X", entry->firstSourceAddress);
      DEBUG_PRINTLN();
    }
    if (!found) {
      DEBUG_PRINTF("[D6-WRITER] %04X value=%02X writer=unrecorded\n",
                   address,
                   MemoryProvenanceBackingValue(selectedBankIndex, address));
    }
  }
  DEBUG_PRINTLN("[D6-WRITER] END");
}

static void DumpLCWriteProvenance(unsigned int selectedBankIndex) {
  if (!LCProvenance) {
    DEBUG_PRINTLN("[LC-PROV] provenance storage unavailable");
    DumpLCTargetSummary(selectedBankIndex);
    return;
  }
  bool any = false;
  DEBUG_PRINTF("[LC-PROV] written bytes %04X-%04X by physical bank:\n",
               MEMORY_PROVENANCE_FIRST, MEMORY_PROVENANCE_LAST);
  for (unsigned int bankIndex = 0; bankIndex < MEMORY_PROVENANCE_BANKS;
       bankIndex++) {
    for (unsigned short address = MEMORY_PROVENANCE_FIRST;
         address <= MEMORY_PROVENANCE_LAST; address++) {
      const LCByteProvenance * entry = LCProvenanceEntry(bankIndex, address);
      if (!entry->writeCount)
        continue;
      any = true;
      DumpLCProvenanceEntry(bankIndex, address, entry);
    }
  }
  if (!any)
    DEBUG_PRINTLN("[LC-PROV] no recorded writes in configured range");
  any = false;
  DEBUG_PRINTF("[SRC-PROV] written bytes %04X-%04X by physical bank:\n",
               MEMORY_SOURCE_FIRST, MEMORY_SOURCE_LAST);
  for (unsigned int bankIndex = 0; bankIndex < MEMORY_SOURCE_BANKS;
       bankIndex++) {
    for (unsigned short address = MEMORY_SOURCE_FIRST;
         address <= MEMORY_SOURCE_LAST; address++) {
      const LCByteProvenance * entry = LCProvenanceEntry(bankIndex, address);
      if (!entry || !entry->writeCount) continue;
      any = true;
      DumpLCProvenanceEntry(bankIndex, address, entry);
    }
  }
  if (!any)
    DEBUG_PRINTLN("[SRC-PROV] no recorded writes in source-watch range");
  DumpLCTargetSummary(selectedBankIndex);
  DumpLCWriterContexts();
}

static void DumpCopyCorrelation(unsigned int destinationBankIndex) {
  DEBUG_PRINTF("[COPY-PROV] source-before-copy captured=%u readerPC=%04X cycle=%llu\n",
               (unsigned) CopySourceBeforeCaptured, CopySourceReaderPC,
               CopySourceReadCycle);
  const unsigned short compareFirst = 0x58DD;
  const unsigned short compareLast = 0x58F0;
  for (unsigned short source = compareFirst; source <= compareLast; source++) {
    unsigned short destination = source + 0x7E00;
    unsigned int sourceIndex = source - COPY_SOURCE_FIRST;
    const CopySourceSnapshotEntry * before =
      CopySourceBeforeCaptured ? &CopySourceBefore[sourceIndex] : NULL;
    unsigned int currentSourceBank = MemoryProvenanceBankIndex(source, false);
    unsigned char currentSource =
      MemoryProvenanceBackingValue(currentSourceBank, source);
    unsigned char destinationValue =
      MemoryProvenanceBackingValue(destinationBankIndex, destination);
    const LCByteProvenance * destinationProvenance =
      LCProvenanceEntry(destinationBankIndex, destination);
    DEBUG_PRINTF("[COPY-PROV] src=%04X before=%s",
                 source, before ? "captured" : "unavailable");
    if (before) DEBUG_PRINTF(":%02X", before->value);
    DEBUG_PRINTF(" current=%02X dst=%04X value=%02X %s",
                 currentSource, destination, destinationValue,
                 currentSource == destinationValue ? "MATCH" : "MISMATCH");
    if (before && before->writeCountKnown)
      DEBUG_PRINTF(" sourceLastWriter=%04X@%llu", before->writerPC,
                   before->writerCycle);
    else if (before)
      DEBUG_PRINT(" sourceLastWriter=unrecorded");
    if (destinationProvenance && destinationProvenance->writeCount) {
      DEBUG_PRINTF(" dstFirst=%04X:%02X:%02X dstLatest=%04X:%02X writes=%u",
                   destinationProvenance->firstPC,
                   destinationProvenance->firstOpcode,
                   destinationProvenance->firstNewValue,
                   destinationProvenance->latestPC,
                   destinationProvenance->latestNewValue,
                   destinationProvenance->writeCount);
      if (before && (destinationProvenance->firstPC == 0x29D8 ||
                     destinationProvenance->firstPC == 0x29D6))
        DEBUG_PRINTF(" copyExact=%u",
                     (unsigned) (before->value ==
                                 destinationProvenance->firstNewValue));
      if (destinationProvenance->firstSourceAddress != 0xFFFF)
        DEBUG_PRINTF(" inferredSource=%04X",
                     destinationProvenance->firstSourceAddress);
      DEBUG_PRINTF(" changedAfterCopy=%u",
                   (unsigned) (destinationProvenance->latestPC != 0x29D8 &&
                               destinationProvenance->latestPC != 0x29D6));
    } else {
      DEBUG_PRINT(" dstWriter=unrecorded");
    }
    DEBUG_PRINTLN();
  }
}

static bool IsConditionalBranchOpcode(unsigned char op) {
  switch (op) {
    case 0x10: case 0x30: case 0x50: case 0x70:
    case 0x90: case 0xB0: case 0xD0: case 0xF0:
      return true;
  }
  return false;
}

static void DumpMemoryLightHistory() {
  if (!MemoryLightHistory || !MemoryLightHistoryCount) {
    DEBUG_PRINTLN("[MEM-HISTORY] no completed instructions retained");
    return;
  }
  DEBUG_PRINTF("[MEM-HISTORY] frozen recent instructions=%u:\n",
               MemoryLightHistoryCount);
  unsigned int first =
    (MemoryLightHistoryNext + MEMORY_LIGHT_HISTORY_SIZE -
     MemoryLightHistoryCount) % MEMORY_LIGHT_HISTORY_SIZE;
  for (unsigned int offset = 0; offset < MemoryLightHistoryCount; offset++) {
    const MemoryLightHistoryEntry * entry =
      &MemoryLightHistory[(first + offset) % MEMORY_LIGHT_HISTORY_SIZE];
    DEBUG_PRINTF("[MEM-HISTORY] PC=%04X op=%02X effective=%04X SR=%02X next=%04X",
                 entry->pc, entry->opcode, entry->effectiveAddress,
                 entry->sr, entry->nextPC);
    if (IsConditionalBranchOpcode(entry->opcode)) {
      unsigned short fallThrough = entry->pc + 2;
      unsigned short target = fallThrough + entry->effectiveAddress;
      DEBUG_PRINTF(" branch=%s target=%04X fallthrough=%04X",
                   entry->nextPC == target ? "taken" : "not-taken",
                   target, fallThrough);
    } else if (entry->opcode == 0x4C || entry->opcode == 0x6C)
      DEBUG_PRINTF(" JMP-target=%04X", entry->nextPC);
    else if (entry->opcode == 0x20)
      DEBUG_PRINTF(" JSR-target=%04X return=%04X", entry->nextPC,
                   entry->pc + 3);
    else if (entry->opcode == 0x60)
      DEBUG_PRINTF(" RTS-target=%04X", entry->nextPC);
    else if (entry->opcode == 0x40)
      DEBUG_PRINTF(" RTI-target=%04X", entry->nextPC);
    DEBUG_PRINTLN();
  }
}

static void DumpMemoryDiagnosticControlFlow() {
  if (!MemoryControlFlow || !MemoryControlFlowCount) {
    DEBUG_PRINTLN("[MEM-FLOW] no recorded execution");
    return;
  }
  DEBUG_PRINTF("[MEM-FLOW] retained instructions=%u trigger=%04X-%04X:\n",
               MemoryControlFlowCount, MEMORY_DIAGNOSTIC_TRIGGER_FIRST,
               MEMORY_DIAGNOSTIC_TRIGGER_LAST);
  unsigned int first = (MemoryControlFlowNext + MEMORY_CONTROL_FLOW_SIZE -
                        MemoryControlFlowCount) % MEMORY_CONTROL_FLOW_SIZE;
  for (unsigned int offset = 0; offset < MemoryControlFlowCount; offset++) {
    const MemoryControlFlowEntry * entry =
      &MemoryControlFlow[(first + offset) % MEMORY_CONTROL_FLOW_SIZE];
    DEBUG_PRINTF("[MEM-FLOW] cycle=%llu PC=%04X op=%02X effective=%04X "
                 "A=%02X X=%02X Y=%02X SP=%02X SR=%02X next=%04X",
                 entry->cycles, entry->pc, entry->opcode,
                 entry->effectiveAddress, entry->a, entry->x, entry->y,
                 entry->sp, entry->sr, entry->nextPC);
    if (entry->kind == 1)
      DEBUG_PRINTF(" branch=%s target=%04X fallthrough=%04X",
                   entry->taken ? "taken" : "not-taken", entry->target,
                   entry->fallThrough);
    else if (entry->kind == 2)
      DEBUG_PRINTF(" JMP-target=%04X", entry->target);
    else if (entry->kind == 3)
      DEBUG_PRINTF(" JSR-target=%04X return=%04X", entry->target,
                   entry->fallThrough);
    else if (entry->kind == 4)
      DEBUG_PRINTF(" RTS-target=%04X", entry->target);
    else if (entry->kind == 5)
      DEBUG_PRINTF(" RTI-target=%04X", entry->target);
    DEBUG_PRINTLN();
  }
}
#endif

void CheckMemoryDiagnosticTrigger(unsigned short instructionPC) {
#if ENABLE_CPU_TRACE
  // This is intentionally the only pre-instruction work: one captured-state
  // test and two integer comparisons. It fires before execCode(), so an
  // instruction which never returns cannot evade the trigger.
  if (!MemoryDiagnosticCaptured &&
      instructionPC >= MEMORY_DIAGNOSTIC_TRIGGER_FIRST &&
      instructionPC <= MEMORY_DIAGNOSTIC_TRIGGER_LAST)
    CaptureMemoryRangeDiagnostics(instructionPC);
#else
  (void) instructionPC;
#endif
}

void RecordMemoryDiagnosticControlFlow(
  unsigned short instructionPC, unsigned char instructionOpcode,
  unsigned short effectiveAddress, unsigned short nextPC) {
#if ENABLE_CPU_TRACE
  if ((!MemoryControlFlow || !MemoryLightHistory) &&
      !EnsureIIeProvenanceDiagnosticsStorage())
    return;
  if (!MemoryDiagnosticCaptured) {
    MemoryLightHistoryEntry * light =
      &MemoryLightHistory[MemoryLightHistoryNext];
    light->pc = instructionPC;
    light->opcode = instructionOpcode;
    light->effectiveAddress = effectiveAddress;
    light->sr = SR;
    light->nextPC = nextPC;
    MemoryLightHistoryNext =
      (MemoryLightHistoryNext + 1) % MEMORY_LIGHT_HISTORY_SIZE;
    if (MemoryLightHistoryCount < MEMORY_LIGHT_HISTORY_SIZE)
      MemoryLightHistoryCount++;
    return;
  }
  if (MemoryDetailedFlowDumped)
    return;
  MemoryControlFlowEntry * entry =
    &MemoryControlFlow[MemoryControlFlowNext];
  memset(entry, 0, sizeof(*entry));
  entry->cycles = TotalCycles;
  entry->pc = instructionPC;
  entry->opcode = instructionOpcode;
  entry->effectiveAddress = effectiveAddress;
  entry->a = A;
  entry->x = X;
  entry->y = Y;
  entry->sp = STP;
  entry->sr = SR;
  entry->nextPC = nextPC;
  if (IsConditionalBranchOpcode(instructionOpcode)) {
    entry->kind = 1;
    entry->fallThrough = instructionPC + 2;
    entry->target = entry->fallThrough + effectiveAddress;
    entry->taken = nextPC == entry->target;
  } else if (instructionOpcode == 0x4C || instructionOpcode == 0x6C) {
    entry->kind = 2;
    entry->target = nextPC;
  } else if (instructionOpcode == 0x20) {
    entry->kind = 3;
    entry->target = nextPC;
    entry->fallThrough = instructionPC + 3;
  } else if (instructionOpcode == 0x60) {
    entry->kind = 4;
    entry->target = nextPC;
  } else if (instructionOpcode == 0x40) {
    entry->kind = 5;
    entry->target = nextPC;
  }
  MemoryControlFlowNext =
    (MemoryControlFlowNext + 1) % MEMORY_CONTROL_FLOW_SIZE;
  if (MemoryControlFlowCount < MEMORY_CONTROL_FLOW_SIZE)
    MemoryControlFlowCount++;
  if (instructionOpcode == 0x00 ||
      MemoryControlFlowCount == MEMORY_CONTROL_FLOW_SIZE) {
    DEBUG_PRINTF("[MEM-FLOW] detailed capture stop reason=%s PC=%04X\n",
                 instructionOpcode == 0x00 ? "BRK" : "buffer-full",
                 instructionPC);
    DumpMemoryDiagnosticControlFlow();
    MemoryDetailedFlowDumped = true;
  }
#else
  (void) instructionPC; (void) instructionOpcode; (void) effectiveAddress;
  (void) nextPC;
#endif
}

void CaptureMemoryRangeDiagnostics(unsigned short address) {
#if ENABLE_CPU_TRACE
  if (MemoryDiagnosticCaptured)
    return;
  MemoryDiagnosticCaptured = true;

  const unsigned short first = MEMORY_PROVENANCE_FIRST;
  const unsigned short last = MEMORY_PROVENANCE_LAST;
  unsigned char * originalROM = OriginalIIeROMBuffer();
  unsigned char * enhancedROM = EnhancedIIeROMBuffer();
  unsigned int selectedBankIndex = MemoryProvenanceBankIndex(first, false);
  unsigned char triggerOpcode =
    (address < 0xC000 || address >= 0xC100) ? read8(address) : 0xFF;

  DEBUG_PRINTLN("[CPU-MEM] BEGIN one-shot configurable memory diagnostic");
  DEBUG_PRINTF("[CPU-MEM] trigger PC=%04X opcode=%02X A=%02X X=%02X Y=%02X "
               "SP=%02X SR=%02X TotalCycles=%llu\n",
               address, triggerOpcode, A, X, Y, STP, SR, TotalCycles);
  DEBUG_PRINT("[CPU-MEM] recent instructions:");
  for (int historyOffset = 0; historyOffset < 16; historyOffset++) {
    unsigned char historyIndex = (CPURecentIndex + historyOffset) & 0x0F;
    DEBUG_PRINTF(" %04X:%02X@%04X", CPURecentPC[historyIndex],
                 CPURecentOpcode[historyIndex],
                 CPURecentArgument[historyIndex]);
  }
  DEBUG_PRINTLN();
  DEBUG_PRINTF("[CPU-MEM] machine profile=%s IsIIeMode=%u Is65C02Mode=%u "
               "IIE_ROM=%p OriginalIIeROM=%p EnhancedIIeROM=%p "
               "originalAvailable=%u enhancedAvailable=%u\n",
               MachineProfileName(), (unsigned) IsIIeMode(),
               (unsigned) Is65C02Mode(), IIE_ROM, originalROM, enhancedROM,
               (unsigned) IIeROMAvailable,
               (unsigned) EnhancedIIeROMIsAvailable());
  DEBUG_PRINTF("[CPU-MEM] mapping LCRAMR=%u LCRAMW=%u LCbank=%u "
               "LCprewrite=%u RAMRD=%u RAMWRT=%u ALTZP=%u 80STORE=%u "
               "INTCXROM=%u SLOTC3ROM=%u internalC8ROM=%u PAGE2=%u HIRES=%u\n",
               (unsigned) (memlcramr != 0), (unsigned) (memlcramw != 0),
               memlcbank2 ? 2U : 1U, (unsigned) memlcprewrite,
               (unsigned) iieRamReadAux, (unsigned) iieRamWriteAux,
               (unsigned) iieAltZeroPage, (unsigned) iie80Store,
               (unsigned) iieIntCxROM, (unsigned) iieSlotC3ROM,
               (unsigned) iieInternalC8ROM, (unsigned) ((gm & PG2) != 0),
               (unsigned) ((gm & HRG) != 0));

  DumpMemoryLightHistory();
  DumpLCWriteProvenance(selectedBankIndex);
  DumpCriticalD6Writers(selectedBankIndex);
  DumpCopyCorrelation(selectedBankIndex);
  DumpMappedMemoryRange("visible", first, last);
  if (first < 0xC000) {
    DumpBackingMemoryRange("main-ram", RAM, first, first, last);
    DumpBackingMemoryRange("aux-ram", AUXRAM, first, first, last);
    DEBUG_PRINTLN("[CPU-MEM] IIe ROM and language-card backing not applicable to configured range");
  } else if (first >= 0xD000) {
    unsigned int romOffset = first - 0xC000;
    unsigned int lcBank1Offset = first - 0xD000;
    unsigned int lcBank2Offset = 0x1000 + first - 0xD000;
    DumpBackingMemoryRange("selected-rom", IIE_ROM, romOffset, first, last);
    DumpBackingMemoryRange("original-iie-rom", originalROM, romOffset, first, last);
    DumpBackingMemoryRange("enhanced-iie-rom", enhancedROM, romOffset, first, last);
    DumpBackingMemoryRange("main-lc-bank1", RAMEXT, lcBank1Offset, first, last);
    DumpBackingMemoryRange("main-lc-bank2", RAMEXT, lcBank2Offset, first, last);
    DumpBackingMemoryRange("aux-lc-bank1", AUXRAMEXT, lcBank1Offset, first, last);
    DumpBackingMemoryRange("aux-lc-bank2", AUXRAMEXT, lcBank2Offset, first, last);
  }
  DumpMappedMemoryRange("source-visible", MEMORY_SOURCE_FIRST,
                        MEMORY_SOURCE_LAST);
  DumpBackingMemoryRange("source-main-ram", RAM, MEMORY_SOURCE_FIRST,
                         MEMORY_SOURCE_FIRST, MEMORY_SOURCE_LAST);
  DumpBackingMemoryRange("source-aux-ram", AUXRAM, MEMORY_SOURCE_FIRST,
                         MEMORY_SOURCE_FIRST, MEMORY_SOURCE_LAST);

  unsigned char * selectedBacking = NULL;
  unsigned int selectedBackingOffset = 0;
  const char * selectedBackingName = "unsupported-range";
  if (first < 0xC000) {
    selectedBacking = selectedBankIndex == 1 ? AUXRAM : RAM;
    selectedBackingOffset = first;
    selectedBackingName = selectedBankIndex == 1 ? "aux-ram" : "main-ram";
  } else if (first >= 0xD000) {
    selectedBacking = iieAltZeroPage ? AUXRAMEXT : RAMEXT;
    selectedBackingOffset = (memlcbank2 ? 0x1000 : 0) + first - 0xD000;
    selectedBackingName = "language-card-ram";
  }
  bool expectedMappingMatch = MappedRangeMatchesBacking(
    selectedBacking, selectedBackingOffset, first, last);
  bool profileROMPointerMatch =
    (MachineProfile == APPLE_IIE_128K && IIE_ROM == originalROM) ||
    (MachineProfile == APPLE_IIE_ENHANCED_128K && IIE_ROM == enhancedROM) ||
    !IsIIeMode();
  DEBUG_PRINTF("[CPU-MEM] provenance selectedBacking=%s buffer=%p bank=%s\n",
               selectedBackingName, selectedBacking,
               MemoryProvenanceBankName(selectedBankIndex));
  DEBUG_PRINTF("[CPU-MEM] mapping-decision expectedSource=%s "
               "expectedBackingMatch=%u profileROMPointerMatch=%u "
               "mappingInvariant=%s\n",
               selectedBackingName,
               (unsigned) expectedMappingMatch,
               (unsigned) profileROMPointerMatch,
               expectedMappingMatch && profileROMPointerMatch ? "OK" : "VIOLATION");
  DEBUG_PRINTLN("[CPU-MEM] END one-shot configurable memory diagnostic");
#else
  (void) address;
#endif
}

static void SetIIeSwitch(unsigned short address) {
  if (!IsIIeMode())
    return;
  switch (address) {
    case 0xC000: iie80Store = false; break;
    case 0xC001: iie80Store = true; break;
    case 0xC002: iieRamReadAux = false; break;
    case 0xC003: iieRamReadAux = true; break;
    case 0xC004: iieRamWriteAux = false; break;
    case 0xC005: iieRamWriteAux = true; break;
    case 0xC006: iieIntCxROM = false; break;
    case 0xC007: iieIntCxROM = true; break;
    case 0xC008: iieAltZeroPage = false; break;
    case 0xC009: iieAltZeroPage = true; break;
    case 0xC00A: iieSlotC3ROM = false; break;
    case 0xC00B: iieSlotC3ROM = true; break;
    case 0xC00C: iie80Column = false; InvalidateVideoCaches(); break;
    case 0xC00D: iie80Column = true; InvalidateVideoCaches(); break;
    case 0xC00E: iieAltCharset = false; InvalidateVideoCaches(); break;
    case 0xC00F: iieAltCharset = true; InvalidateVideoCaches(); break;
  }
}

/***************************************************************************************************************************************/

/***************************************************************************************************************************************/
unsigned char readPgz8(unsigned short address) {
#if ENABLE_KLAUS_CPU_TEST
    if (CPUValidationFlatMemory)
      return CPUValidationMemory[address];
#endif
    return IIeUseAuxiliaryRAM(address, false) ? AUXRAM[address] : RAM[address];
}

/***************************************************************************************************************************************/

/***************************************************************************************************************************************/
#if ENABLE_CPU_TRACE
static void ObserveCopySourceRead(unsigned short address) {
  if (CopySourceBeforeCaptured || address < COPY_SOURCE_FIRST ||
      address > COPY_SOURCE_LAST || CPUInstructionStartPC < 0x29D0 ||
      CPUInstructionStartPC > 0x29DF || !CopySourceBefore)
    return;
  CopySourceBeforeCaptured = true;
  CopySourceReadCycle = TotalCycles;
  CopySourceReaderPC = CPUInstructionStartPC;
  for (unsigned short source = COPY_SOURCE_FIRST;
       source <= COPY_SOURCE_LAST; source++) {
    unsigned int index = source - COPY_SOURCE_FIRST;
    unsigned int bankIndex = MemoryProvenanceBankIndex(source, false);
    unsigned char * backing = bankIndex == 1 ? AUXRAM : RAM;
    CopySourceBefore[index].value = backing ? backing[source] : 0;
    CopySourceBefore[index].bankIndex = bankIndex;
    LCByteProvenance * provenance = LCProvenanceEntry(bankIndex, source);
    if (provenance && provenance->writeCount) {
      CopySourceBefore[index].writerCycle = provenance->latestCycle;
      CopySourceBefore[index].writerPC = provenance->latestPC;
      CopySourceBefore[index].writeCountKnown = 1;
    }
  }
}
#endif

unsigned char read8(unsigned short address) {
#if ENABLE_KLAUS_CPU_TEST
  if (CPUValidationFlatMemory)
    return CPUValidationMemory[address];
#endif
#if ENABLE_CPU_TRACE
  ObserveCopySourceRead(address);
#endif
  unsigned char page = address>>8;
  if(page < 0xC0) {
    return IIeUseAuxiliaryRAM(address, false) ? AUXRAM[address] : RAM[address];
	} else if (page == 0xC6 && (!IsIIeMode() || !iieIntCxROM)) {
		return DISK_ROM[address - 0xC600];
  } else if (page >= 0xD0) {
      if (!memlcramr)
        return IsIIeMode() ? IIE_ROM[address - 0xC000] : ROM[address-0xD000];
      return (IsIIeMode() && iieAltZeroPage ? AUXRAMEXT : RAMEXT)[LanguageCardIndex(address)];
  } else {
    if (IsIIeMode() && address >= 0xC100) {
      bool internal = iieIntCxROM || (page == 0xC3 && !iieSlotC3ROM) ||
                      (address >= 0xC800 && iieInternalC8ROM);
      if (page == 0xC3 && !iieSlotC3ROM)
        iieInternalC8ROM = true;
      if (internal) {
        unsigned char value = IIE_ROM[address - 0xC000];
        if (address == 0xCFFF)
          iieInternalC8ROM = false;
        return value;
      }
      if (address == 0xCFFF)
        iieInternalC8ROM = false;
    }
    // Keyboard Data
    if(address == 0xC000) return keyboard_read(); else
    // Keyboard Strobe
    if(address == 0xC010) keyboard_strobe(); else
    if(address == 0xC011) return (memlcbank2  | (k&0x7f)); else
    if(address == 0xC012) return (memlcramr   | (k&0x7f)); else
    if(address == 0xC013 && IsIIeMode()) return IIeStatus(iieRamReadAux); else
    if(address == 0xC014 && IsIIeMode()) return IIeStatus(iieRamWriteAux); else
    if(address == 0xC015 && IsIIeMode()) return IIeStatus(iieIntCxROM); else
    if(address == 0xC016 && IsIIeMode()) return IIeStatus(iieAltZeroPage); else
    if(address == 0xC017 && IsIIeMode()) return IIeStatus(iieSlotC3ROM); else
    if(address == 0xC018 && IsIIeMode()) return IIeStatus(iie80Store); else
    if(address == 0xC01A && IsIIeMode()) return IIeStatus(!(gm & GRX)); else
    if(address == 0xC01B && IsIIeMode()) return IIeStatus(gm & SPL); else
    if(address == 0xC01C && IsIIeMode()) return IIeStatus(gm & PG2); else
    if(address == 0xC01D && IsIIeMode()) return IIeStatus(gm & HRG); else
    if(address == 0xC01E && IsIIeMode()) return IIeStatus(iieAltCharset); else
    if(address == 0xC01F && IsIIeMode()) return IIeStatus(iie80Column); else
    if(address == 0xC019) { 
    } 
    else
    if(address >= 0xC061 && address <= 0xC063)
      return IIeStatus(HostJoystickButton(address - 0xC061)); else
    if(address >= 0xC064 && address <= 0xC067) {
      int paddle = address - 0xC064;
      uint64_t elapsed = TotalCycles - paddleResetCycle;
      return IIeStatus(elapsed < (uint64_t) HostPaddleValue(paddle) * 11ULL + 8ULL);
    } else
    if(address == 0xC070) {
      paddleResetCycle = TotalCycles;
      return k & 0x7F;
    } else
    // Speaker toggle
    if(address == 0xC030) speaker_toggle(); else
		/* Video resolution */
		if (address >= 0xC050 && address <= 0xC05F)
			CheckVideoIO (address);  else
		/* Bank Memory 1/2 */
		if (address >= 0xC080 && address <= 0xC08F)
			CheckBankMemoIO (address);  else
		/* Slot #6 Softswitches */
		if (address >= 0xC0E0 && address <= 0xC0EF)
			return ReadDiskIO (address); else
      {
      }
    return 0;
  }
}

/***************************************************************************************************************************************/

/***************************************************************************************************************************************/
unsigned short read16(unsigned short address) {
  return (unsigned short)read8(address) | (((unsigned short)read8(address+1))<<8);
}

/***************************************************************************************************************************************/

/***************************************************************************************************************************************/
void writePgz8(unsigned short address, unsigned char value) {
#if ENABLE_KLAUS_CPU_TEST
    if (CPUValidationFlatMemory) {
      CPUValidationMemory[address] = value;
      return;
    }
#endif
    if (IIeUseAuxiliaryRAM(address, true)) AUXRAM[address] = value;
    else RAM[address] = value;
}

/***************************************************************************************************************************************/

/***************************************************************************************************************************************/
void write8(unsigned short address, unsigned char value) {
#if ENABLE_KLAUS_CPU_TEST
  if (CPUValidationFlatMemory) {
    CPUValidationMemory[address] = value;
    return;
  }
#endif
  unsigned char page = address >> 8;
  if (page < 0xC0)
  {
    bool auxiliary = IIeUseAuxiliaryRAM(address, true);
    unsigned char * target = auxiliary ? AUXRAM : RAM;
#if ENABLE_CPU_TRACE
    if ((address >= MEMORY_PROVENANCE_FIRST &&
         address <= MEMORY_PROVENANCE_LAST) ||
        (address >= MEMORY_SOURCE_FIRST && address <= MEMORY_SOURCE_LAST))
      RecordLCWrite(address, target[address], value);
#endif
    target[address] = value;
  }
  else if (page >= 0xD0)
  {
    if (memlcramw) {
      unsigned char * lcBuffer = IsIIeMode() && iieAltZeroPage ? AUXRAMEXT : RAMEXT;
      unsigned int lcIndex = LanguageCardIndex(address);
#if ENABLE_CPU_TRACE
        if ((address >= MEMORY_PROVENANCE_FIRST &&
             address <= MEMORY_PROVENANCE_LAST) ||
            (address >= MEMORY_SOURCE_FIRST && address <= MEMORY_SOURCE_LAST))
          RecordLCWrite(address, lcBuffer[lcIndex], value);
#endif
      lcBuffer[lcIndex] = value;
    }
  }
  else
  {
	  if (address >= 0xC000 && address <= 0xC00F)
	    SetIIeSwitch(address);
	  else
  	// Keyboard Strobe
  	if (address == 0xC010) keyboard_strobe();
  	else
		if (address == 0xC070)
			paddleResetCycle = TotalCycles;
		else
  		// Speaker toggle
  		if (address == 0xC030) speaker_toggle();
  		else
			/* Video resolution */
  			if (address >= 0xC050 && address <= 0xC05F)
  				CheckVideoIO(address);
  			else
				/* Language-card soft switches respond to writes too. */
				if (address >= 0xC080 && address <= 0xC08F)
					CheckBankMemoIO(address);
				else
  				/*Slot #6 Softswitches */
  				if (address >= 0xC0E0 && address <= 0xC0EF)
  					WriteDiskIO(address, value);
  				else
  				{
  				}
  }}

/***************************************************************************************************************************************/

/***************************************************************************************************************************************/
void CheckBankMemoIO(word Address) {
  unsigned char mode = Address & 0x03;

  // $C080-$C087 select bank 2; $C088-$C08F select bank 1.
  memlcbank2 = (Address & 0x08) ? 0x00 : 0x80;
  memlcramr = (mode == 0 || mode == 3) ? 0x80 : 0x00;

  // Hardware requires two consecutive accesses to an odd LC switch before
  // writes are enabled. Accessing an even switch immediately protects RAM.
  if (Address & 0x01) {
    memlcramw = memlcprewrite ? 0x80 : 0x00;
    memlcprewrite = true;
  } else {
    memlcramw = 0x00;
    memlcprewrite = false;
  }
}
